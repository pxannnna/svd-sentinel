# TESTDEV register map
File version: 1.0
test device
Registers are 32-bit, read-write, reset 0x0 unless marked. A register's access mark holds for its fields unless they carry their own. Offsets are from the block's base; lines under a group give offsets from that group; [hi:lo] are bit positions; {n}, {i} and the like mark numbered series; 'fields as' and 'values as' point back to an identical list; <NAME> marks a mode.

## Memory map
0x40000000 TESTP — test peripheral

## TESTP — test peripheral
Base 0x40000000
{0x0+4i} CH[{i}] (i=0..3) — channel register
